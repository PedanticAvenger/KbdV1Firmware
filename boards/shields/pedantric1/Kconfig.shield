## boards/shields/pedantric1/Kconfig.shield
```kconfig
config SHIELD_pedantic1_DONGLE
    def_bool $(shields_list_contains,pedantic1_dongle)

config SHIELD_pedantic1_LEFT
    def_bool $(shields_list_contains,pedantic1_left)

config SHIELD_pedantic1_RIGHT
    def_bool $(shields_list_contains,pedantic1_right)
```

## boards/shields/rcr1/Kconfig.defconfig
```kconfig
if SHIELD_rcr1_LEFT

config ZMK_KEYBOARD_NAME
    default "RcR1"

config ZMK_SPLIT_ROLE_CENTRAL
    default y

endif # SHIELD_rcr1_LEFT

if SHIELD_rcr1_LEFT || SHIELD_rcr1_RIGHT

config ZMK_SPLIT
    default y

config SPI
    default y

config ZMK_RGB_UNDERGLOW
    select WS2812_STRIP
    select SPI

endif # SHIELD_rcr1_LEFT || SHIELD_rcr1_RIGHT
```

## boards/shields/rcr1/Kconfig.shield
```kconfig
config SHIELD_rcr1_LEFT
    def_bool $(shields_list_contains,rcr1_left)

config SHIELD_rcr1_RIGHT
    def_bool $(shields_list_contains,rcr1_right)
```

## config/west.yml
```yaml
manifest:
  remotes:
    - name: zmkfirmware
      url-base: https://github.com/zmkfirmware
    - name: rianadon
      url-base: https://github.com/rianadon
    - name: pedantic
      url-base: https://github.com/PedanticAvenger
  projects:
    - name: zmk
      remote: rianadon
      revision: main
      import: app/west.yml
    - name: zmk-dongle-screen
      remote: pedantic
      revision: main
  self:
    path: config
    import: deps.yml
```
