
#include "rcr1.dtsi"

/ {
    bootloader_key: bootloader_key {
        compatible = "zmk,boot-magic-key";
        key-position = <13>;
        jump-to-bootloader;
    };
};

&default_transform {
    col-offset = <13>;
};

&right_encoder {
    status = "okay"; // <-- This enables it for this side
};